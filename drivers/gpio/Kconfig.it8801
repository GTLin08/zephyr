## drivers/gpio/Kconfig.it8801
```kconfig
# Copyright (c) 2024 ITE Corporation. All Rights Reserved.
# SPDX-License-Identifier: Apache-2.0

config GPIO_ITE_IT8801
	bool "ITE IT8801 GPIO device driver"
	default y
	depends on DT_HAS_ITE_IT8801_GPIO_ENABLED
	select I2C
	select MFD
	help
	  Enable driver for ITE IT8801 I2C-based GPIO.

if GPIO_ITE_IT8801

config GPIO_IT8801_INIT_PRIORITY
	int "IT8801 GPIO port init priority"
	default 85
	help
	  IT8801 GPIO port device driver initialization priority. The priority
	  must be lower than MFD_INIT_PRIORITY device.

endif # GPIO_ITE_IT8801
```

## drivers/gpio/Kconfig.it8xxx2
```kconfig
# Copyright (c) 2020 ITE Corporation. All Rights Reserved.
# SPDX-License-Identifier: Apache-2.0

config GPIO_ITE_IT8XXX2
	bool "ITE IT8XXX2 GPIO driver"
	default y
	depends on DT_HAS_ITE_IT8XXX2_GPIO_ENABLED
	help
	  Enable driver for the ite GPIO controller.

config GPIO_ITE_IT8XXX2_V2
	bool "ITE IT8XXX2 GPIO driver V2"
	default y
	depends on DT_HAS_ITE_IT8XXX2_GPIO_V2_ENABLED
	help
	  Enable driver for the ite GPIO V2 controller.
```

## drivers/pwm/Kconfig.it8801
```kconfig
# Copyright (c) 2024 ITE Corporation. All Rights Reserved.
# SPDX-License-Identifier: Apache-2.0

config PWM_ITE_IT8801
	bool "ITE IT8801 PWM device driver"
	default y
	depends on DT_HAS_ITE_IT8801_PWM_ENABLED
	select I2C
	select MFD
	help
	   Enable driver for ITE IT8801 I2C-based PWM.
	   Supports 7 open-drain/push-pull outputs.

if PWM_ITE_IT8801

config PWM_IT8801_INIT_PRIORITY
	int "IT8801 PWM port init priority"
	default 85
	help
	  IT8801 PWM device driver initialization priority. The priority
	  must be lower than MFD_INIT_PRIORITY device.

endif # PWM_ITE_IT8801
```

## dts/bindings/gpio/ite,it8xxx2-gpio-v2.yaml
```yaml
# Copyright (c) 2022 ITE Corporation. All Rights Reserved.
# SPDX-License-Identifier: Apache-2.0

description: This binding gives a base representation of the ITE gpio

compatible: "ite,it8xxx2-gpio-v2"

include: [gpio-controller.yaml, base.yaml]

properties:
    reg:
      required: true

    wucctrl:
      type: phandles
      description: |
        WUCs are mapped to the pins of GPIO.
        The WUC groups internal and external inputs, and asserts
        a wake-up signal to the INTC, allowing the CPU to exit
        Doze/Deep Doze/Sleep modes.

gpio-cells:
  - pin
  - flags
```

## dts/bindings/i2c/ite,common-i2c.yaml
```yaml
# Copyright (c) 2022 ITE Corporation. All Rights Reserved.
# SPDX-License-Identifier: Apache-2.0

description: Common fields for ITE it8xxx2 I2C

include: [i2c-controller.yaml, pinctrl-device.yaml]

properties:
    reg:
      required: true

    interrupts:
      required: true

    port-num:
      type: int
      required: true
      description: Ordinal identifying the port

    gpio-dev:
        type: phandle
        required: true
        description: Get the handle of the GPIO device

    clock-gate-offset:
      type: int
      required: true
      description: |
        The clock gate offsets combine the register offset from
        ECPM_BASE and the mask within that register into one value.
```

## dts/bindings/interrupt-controller/ite,it51xxx-wuc.yaml
```yaml
# Copyright (c) 2025 ITE Corporation. All Rights Reserved.
# SPDX-License-Identifier: Apache-2.0

description: ITE Wake-Up Controller (WUC)
compatible: "ite,it51xxx-wuc"

include: [base.yaml]

properties:
  reg:
    required: true

  wakeup-controller:
    type: boolean
    description: |
      conveys that this node is a wakeup controller

  both-edge-trigger:
    type: boolean
    description: |
      Rising-edge or falling-edge triggered is selected.
      This property is ignored when using wakeup controller
      version 2 (CONFIG_ITE_IT51XXX_WUC_V2).

  "#wuc-cells":
    type: int
    required: true
    description: |
      number of items to expect in a wakeup controller specifier
    const: 1

wuc-cells:
  - mask
```

## dts/bindings/memory-controllers/ite,it8xxx2-ilm.yaml
```yaml
# Copyright (c) 2022 The ChromiumOS Authors
# SPDX-License-Identifier: Apache-2.0

description: ITE IT8XXX2 Instruction Local Memory
compatible: "ite,it8xxx2-ilm"
include: base.yaml
properties:
  reg:
    required: true

  ilm-size:
    type: int
    description: |
      Configurable instruction local memory size.
```

## dts/bindings/peci/ite,it8xxx2-peci.yaml
```yaml
# Copyright (c) 2022 ITE Corporation. All Rights Reserved.
# SPDX-License-Identifier: Apache-2.0

description: ITE it8xxx2 PECI

compatible: "ite,peci-it8xxx2"

include: [peci.yaml, pinctrl-device.yaml]
```

## dts/bindings/pinctrl/ite,it8xxx2-pinctrl-func.yaml
```yaml
# Copyright (c) 2022 ITE Corporation. All Rights Reserved.
# SPDX-License-Identifier: Apache-2.0

description: ITE IT8XXX2 pin controller function node

compatible: "ite,it8xxx2-pinctrl-func"

include: base.yaml

properties:
    reg:
      required: true

    func3-gcr:
        type: array
        required: true

    func3-en-mask:
        type: array
        required: true

    func4-gcr:
        type: array
        required: true

    func4-en-mask:
        type: array
        required: true

    gpios:
      type: phandle-array
      required: true

pinmux-cells:
  - pin
  - alt_fun
```

## dts/bindings/pinctrl/ite,it8xxx2-pinctrl.yaml
```yaml
# Copyright (c) 2022 ITE Corporation. All Rights Reserved.
# SPDX-License-Identifier: Apache-2.0

description: |
    The ITE IT8XXX2 pin controller is a node responsible for controlling
    pin function selection and pin properties. For example, you can
    use this node to route UART1 RX and TX setting the alternate
    function on the pin.

    The node has the 'pinctrl' node label set in your SoC's devicetree,
    so you can modify it like this:

      &pinctrl {
              /* your modifications go here */
      };

    All device pin configurations should be placed in child nodes of the
    'pinctrl' node, as shown in this example:

      /* You can put this in places like a board-pinctrl.dtsi file in
       * your board directory, or a devicetree overlay in your application.
       */

      /* include pre-defined pins and functions for the SoC used by the board */
      #include <dt-bindings/pinctrl/it8xxx2-pinctrl.h>

      &pinctrl {
        /* configuration for UART0 default state */
        pinctrl_uart1_rx: uart1_rx {
          pinmuxs = <&pinctrlb 0 IT8XXX2_PINMUX_FUNC_3>;
        };
        pinctrl_uart1_tx: uart1_tx {
          pinmuxs = <&pinctrlb 1 IT8XXX2_PINMUX_FUNC_3>;
        };
      };

    The 'pinctrl_uart1_rx' child node encodes the pin configurations
    for a particular state of a device; in this case, the default
    (that is, active) sate.

    To link pin configurations with a device, use a pinctrl-N property for some
    number N, like this example you could place in your board's DTS file:

      #include "board-pinctrl.dtsi"

      &uart0 {
        pinctrl-0 = <&pinctrl_uart1_rx &pinctrl_uart1_tx>;
        pinctrl-1 = <&pinctrl_uart1_rx_sleep &pinctrl_uart1_tx_sleep>;
        pinctrl-2 = <&pinctrl_uart1_rx_priv &pinctrl_uart1_tx_priv>;
        pinctrl-names = "default", "sleep", "priv_start";
      };

compatible: "ite,it8xxx2-pinctrl"

include:
    - name: base.yaml
    - name: pincfg-node.yaml
      child-binding:
        property-allowlist:
          - bias-high-impedance
          - bias-pull-pin-default
          - bias-pull-up
          - bias-pull-down
          - input-enable
          - input-disable
          - gpio-voltage-1p8
          - gpio-voltage-3p3

properties:
    reg:
      required: true

child-binding:
    description: |
        This binding gives a base representation of the ITE IT8XXX2 pins configration.
    properties:
        pinmuxs:
          required: true
          type: phandle-array
          description: |
              ITE IT8XXX2 pin's configuration (port, pin and function).

        gpio-voltage-3p3:
          required: false
          type: boolean
          description: |
              Input voltage selection 3.3V

        gpio-voltage-1p8:
          required: false
          type: boolean
          description: |
              Input voltage selection 1.8V
```

## tests/kernel/usage/thread_runtime_stats/boards/it8xxx2_evb_it81302bx.conf
```kconfig
# Copyright (c) 2026 ITE Technology Corporation
# SPDX-License-Identifier: Apache-2.0

CONFIG_SOC_IT8XXX2_KERNEL_IN_RAM=y
```
