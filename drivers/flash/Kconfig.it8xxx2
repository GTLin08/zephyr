## drivers/flash/Kconfig.it8xxx2
```kconfig
# FLASH configuration options

# Copyright (c) 2020 ITE Corporation. All Rights Reserved.
# SPDX-License-Identifier: Apache-2.0

config SOC_FLASH_ITE_IT8XXX2
	bool "ITE IT8XXX2 flash driver"
	help
	  Enable the ITE it8xxx2 series internal flash driver.
```

## drivers/pwm/Kconfig.it8xxx2
```kconfig
# IT8XXX2 PWM configuration options

# Copyright (c) 2020 ITE Corporation. All Rights Reserved.
# SPDX-License-Identifier: Apache-2.0

config PWM_ITE_IT8XXX2
	bool "ITE IT8XXX2 PWM driver"
	help
	   Enable PWM support on it8xxx2_evb
```

## drivers/serial/Kconfig.it8xxx2
```kconfig
# Copyright (c) 2020 ITE Corporation. All Rights Reserved.
# SPDX-License-Identifier: Apache-2.0

config UART_ITE_IT8XXX2
	bool "ITE serial uart driver"
	select SERIAL_HAS_DRIVER
	select SERIAL_SUPPORT_INTERRUPT
	help
	  This option enables the ITE serial uart driver.
	  This driver can be used for the serial hardware
	  available on ITE EV-boards.
```

## dts/bindings/pwm/ite,it8xxx2-pwm.yaml
```yaml
# Copyright (c) 2020 ITE Corporation. All Rights Reserved.
# SPDX-License-Identifier: Apache-2.0

description: ITE it8xxx2 PWM

compatible: "ite,it8xxx2-pwm"

include: [pwm-controller.yaml, base.yaml]

properties:
    clock-frequency:
      type: int
      required: true
      description: Clock frequency information for PWM operation

    reg:
      required: true

    interrupts:
      required: false

    pwm-prescaler:
      type: int
      required: true

    "#pwm-cells":
      const: 2

pwm-cells:
  - channel
  - flags
```

## dts/bindings/serial/it8xxx2-uart.yaml
```yaml
# Copyright (c) 2020 ITE Corporation. All Rights Reserved.
# SPDX-License-Identifier: Apache-2.0

description: ITE it8xxx2 ns16550 UART

compatible: "it8xxx2-uart"

include: uart-controller.yaml

properties:
    reg:
      required: true

    interrupts:
      required: true

    label:
      required: true
```
